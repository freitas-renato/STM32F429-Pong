## boards/pullup/bap6000/Kconfig.bap6000
```kconfig
# Copyright (c) 2016 Linaro Limited.
# SPDX-License-Identifier: Apache-2.0

config BOARD_BAP6000
	select SOC_STM32F429XX
```

## boards/pullup/bap6000/bap6000_defconfig
```kconfig
# SPDX-License-Identifier: Apache-2.0

# Enable MPU
CONFIG_ARM_MPU=y

# Enable HW stack protection
CONFIG_HW_STACK_PROTECTION=y

CONFIG_SERIAL=y

# enable GPIO
CONFIG_GPIO=y
CONFIG_I2C=y
CONFIG_PWM=y

# Display Driver
CONFIG_DISPLAY=y
CONFIG_ST7789V=y
```
